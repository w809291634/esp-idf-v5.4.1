## examples/_my_examples/SmartCar_wifi_gamepad/sdkconfig.defaults
```kconfig
# ESP32S3
CONFIG_IDF_TARGET="esp32s3"
CONFIG_IDF_TARGET_ESP32S3=y
CONFIG_ESP32S3_DEFAULT_CPU_FREQ_240=y
CONFIG_ESP32S3_DEFAULT_CPU_FREQ_MHZ=240

# SPI flash
CONFIG_ESPTOOLPY_FLASHSIZE_8MB=y
CONFIG_ESPTOOLPY_FLASHMODE_QIO=y
CONFIG_ESPTOOLPY_FLASHMODE="qio"
CONFIG_ESPTOOLPY_FLASHFREQ_80M=y

# USE USB-OTG for console ,Need to delete
# CONFIG_ESP_SYSTEM_PANIC_PRINT_HALT=y

## LOG
# Reduce bootloader log verbosity
# CONFIG_BOOTLOADER_LOG_LEVEL_WARN=y
# CONFIG_BOOTLOADER_LOG_LEVEL=2
# CONFIG_LOG_DEFAULT_LEVEL_WARN=y
CONFIG_LOG_COLORS=y

# Increase main task stack size
CONFIG_ESP_MAIN_TASK_STACK_SIZE=7168
CONFIG_FREERTOS_TIMER_TASK_STACK_DEPTH=4096

# Enable filesystem
CONFIG_PARTITION_TABLE_CUSTOM=y
CONFIG_PARTITION_TABLE_CUSTOM_FILENAME="partitions_example.csv"
CONFIG_PARTITION_TABLE_FILENAME="partitions_example.csv"

# Enable FreeRTOS stats formatting functions, needed for 'tasks' command
CONFIG_FREERTOS_USE_TRACE_FACILITY=y
CONFIG_FREERTOS_USE_STATS_FORMATTING_FUNCTIONS=y
# Enable CPU usage
CONFIG_FREERTOS_GENERATE_RUN_TIME_STATS=y
CONFIG_FREERTOS_HZ=1000

# On chips with USB serial, disable secondary console which does not make sense when using console component
CONFIG_ESP_CONSOLE_SECONDARY_NONE=y
# USE USB-OTG for console ,delete for UART0
CONFIG_ESP_CONSOLE_USB_CDC=y

#
# camera-optionally
#
CONFIG_SPIRAM_MALLOC_ALWAYSINTERNAL=1580
CONFIG_FREERTOS_IDLE_TASK_STACKSIZE=1536
CONFIG_HTTPD_MAX_REQ_HDR_LEN=1214
CONFIG_CAMERA_TASK_STACK_SIZE=4096

#
# wifi-iperf-specific
#
CONFIG_MEMMAP_SMP=y
CONFIG_ESP_SYSTEM_EVENT_TASK_STACK_SIZE=4096
CONFIG_FREERTOS_UNICORE=n

CONFIG_ESP_INT_WDT=n
CONFIG_ESP_TASK_WDT=n

CONFIG_LWIP_ETHARP_TRUST_IP_MAC=n
CONFIG_LWIP_IRAM_OPTIMIZATION=y

# LVGL
CONFIG_LV_CONF_SKIP=y
CONFIG_LV_USE_OBSERVER=y
CONFIG_LV_USE_SYSMON=y
CONFIG_EXAMPLE_LCD_CONTROLLER_ST7789=y
CONFIG_LV_USE_DEMO_WIDGETS=y
CONFIG_LV_USE_PERF_MONITOR=y
CONFIG_LCD_SPI_USE_IOMUX_PINS=n

# STA MODE
CONFIG_ESP_WIFI_AP_SSID=""
CONFIG_ESP_WIFI_SSID="ESP32-Camera"
CONFIG_ESP_WIFI_PASSWORD="wh123456"
```

## examples/_my_examples/SmartCar_wifi_gamepad/sdkconfig.defaults.esp32s3
```kconfig
CONFIG_SPIRAM=y
CONFIG_SPIRAM_MODE_QUAD=y
CONFIG_SPIRAM_SPEED_40M=y
CONFIG_SPIRAM_SUPPORT=y
CONFIG_ESP32_SPIRAM_SUPPORT=y
CONFIG_ESP32S2_SPIRAM_SUPPORT=y
CONFIG_ESP32S3_SPIRAM_SUPPORT=y
CONFIG_SPIRAM_MEMTEST=n

# Enabling the following configurations can help increase the PCLK frequency in the case when
# the Frame Buffer is allocated from the PSRAM and fetched by EDMA
CONFIG_SPIRAM_XIP_FROM_PSRAM=y

CONFIG_EXAMPLE_WIFI_SSID="Xiaomi_ED74"
CONFIG_EXAMPLE_WIFI_PASSWORD="EzSY7G3R"

#
# ESP32S3-wifi-iperf-specific
#
CONFIG_ESP32_WIFI_STATIC_RX_BUFFER_NUM=16
CONFIG_ESP32_WIFI_DYNAMIC_RX_BUFFER_NUM=64
CONFIG_ESP32_WIFI_DYNAMIC_TX_BUFFER_NUM=64
CONFIG_ESP32_WIFI_AMPDU_TX_ENABLED=y
CONFIG_ESP32_WIFI_TX_BA_WIN=32
CONFIG_ESP32_WIFI_AMPDU_RX_ENABLED=y
CONFIG_ESP32_WIFI_RX_BA_WIN=32

CONFIG_LWIP_TCP_SND_BUF_DEFAULT=65535
CONFIG_LWIP_TCP_WND_DEFAULT=65535
CONFIG_LWIP_TCP_RECVMBOX_SIZE=64
CONFIG_LWIP_UDP_RECVMBOX_SIZE=64
CONFIG_LWIP_TCPIP_RECVMBOX_SIZE=64

CONFIG_ESP32S3_INSTRUCTION_CACHE_32KB=y
CONFIG_ESP32S3_INSTRUCTION_CACHE_LINE_32B=y
# CONFIG_ESP32S3_INSTRUCTION_CACHE_WRAP=y

CONFIG_CAMERA_MODULE_ESP_S3_EYE=y
CONFIG_CAMERA_CORE0=y
```

## examples/_my_examples/Template/base_spilcd_http_cam_template/main/Kconfig.projbuild
```kconfig
menu "Application Configuration"

    menu "Console Options"

        config APP_ENABLE_CONSOLE
            bool "Enable Console Support"
            default y
            help
                Enable console command line support. This allows the application
                to accept commands via UART and execute them.

        if APP_ENABLE_CONSOLE

            config CONSOLE_STORE_HISTORY
                bool "Store command history in flash"
                default n
                help
                    Linenoise line editing library provides functions to save and load
                    command history. If this option is enabled, initializes a FAT filesystem
                    and uses it to store command history.

            config CONSOLE_IGNORE_EMPTY_LINES
                bool "Ignore empty lines inserted into the console"
                default y
                help
                    If an empty line is inserted to the console, the Console can either
                    ignore empty lines (the example would continue), or break on empty lines
                    (the example would stop after an empty line).

            config FORCE_SUPPORTS_ESCAPE_SEQ
                bool "Force support for terminal escape sequences"
                default y
                help
                    Some terminal programs support escape sequences (e.g., ANSI codes)
                    for color, cursor movement, and screen control. If this option is enabled,
                    the console will assume the terminal supports these escape sequences,
                    even if automatic detection fails.

        endif # APP_ENABLE_CONSOLE

    endmenu # "Console Options"

    menu "lvgl Application Configuration"

        choice EXAMPLE_LCD_CONTROLLER
            prompt "LCD controller model"
            default EXAMPLE_LCD_CONTROLLER_ILI9341
            help
                Select LCD controller model

            config EXAMPLE_LCD_CONTROLLER_ILI9341
                bool "ILI9341"

            config EXAMPLE_LCD_CONTROLLER_GC9A01
                bool "GC9A01"

            config EXAMPLE_LCD_CONTROLLER_ST7789
                bool "ST7789"

        endchoice

        config EXAMPLE_LCD_TOUCH_ENABLED
            bool "Enable LCD touch"
            default n
            help
                Enable this option if you wish to use display touch. You can select from touch controllers.

        choice EXAMPLE_LCD_TOUCH_CONTROLLER
            prompt "LCD touch controller model"
            depends on EXAMPLE_LCD_TOUCH_ENABLED
            default EXAMPLE_LCD_TOUCH_CONTROLLER_STMPE610
            help
                Select LCD touch controller model

            config EXAMPLE_LCD_TOUCH_CONTROLLER_STMPE610
                bool "STMPE610"
                help
                    Touch controller STMPE610 connected via SPI.
        endchoice

    endmenu

    menu "esp32Cam Configuration"

        config EXAMPLE_BASIC_AUTH
            bool "Basic Authentication"
            default n
            help
                Basic Authentication is a method for an HTTP user agent (e.g. a web browser)
                to provide a user name and password when making a request. It is the simplest
                technique for enforcing access controls to web resources. because it doesn't
                require cookies, session identifiers, or login pages; rather, it uses standard
                fields in the HTTP header.
                Note that, Basic Authentication is not encrypted channel and also easy to retrieve
                credentials as they are sent in plain text format.

        config EXAMPLE_BASIC_AUTH_USERNAME
            string "Basic Authenticate User Name"
            depends on EXAMPLE_BASIC_AUTH
            default "ESP32"
            help
                The client's user name which used for basic authenticate.

        config EXAMPLE_BASIC_AUTH_PASSWORD
            string "Basic Authenticate Password"
            depends on EXAMPLE_BASIC_AUTH
            default "ESP32Webserver"
            help
                The client's password which used for basic authenticate.

    endmenu
endmenu
```

## examples/_my_examples/Template/base_spilcd_http_cam_template/sdkconfig.defaults.esp32s3
```kconfig
CONFIG_SPIRAM=y
CONFIG_SPIRAM_MODE_OCT=y
CONFIG_SPIRAM_SPEED_80M=y

# Enabling the following configurations can help increase the PCLK frequency in the case when
# the Frame Buffer is allocated from the PSRAM and fetched by EDMA
CONFIG_SPIRAM_XIP_FROM_PSRAM=y

CONFIG_EXAMPLE_WIFI_SSID="Xiaomi_ED74"
CONFIG_EXAMPLE_WIFI_PASSWORD="EzSY7G3R"
```

## examples/_my_examples/Template/base_spilcd_rtsp_cam_template/main/Kconfig.projbuild
```kconfig
menu "Application Configuration"

    menu "Console Options"

        config APP_ENABLE_CONSOLE
            bool "Enable Console Support"
            default y
            help
                Enable console command line support. This allows the application
                to accept commands via UART and execute them.

        if APP_ENABLE_CONSOLE

            config CONSOLE_STORE_HISTORY
                bool "Store command history in flash"
                default n
                help
                    Linenoise line editing library provides functions to save and load
                    command history. If this option is enabled, initializes a FAT filesystem
                    and uses it to store command history.

            config CONSOLE_IGNORE_EMPTY_LINES
                bool "Ignore empty lines inserted into the console"
                default y
                help
                    If an empty line is inserted to the console, the Console can either
                    ignore empty lines (the example would continue), or break on empty lines
                    (the example would stop after an empty line).

            config FORCE_SUPPORTS_ESCAPE_SEQ
                bool "Force support for terminal escape sequences"
                default y
                help
                    Some terminal programs support escape sequences (e.g., ANSI codes)
                    for color, cursor movement, and screen control. If this option is enabled,
                    the console will assume the terminal supports these escape sequences,
                    even if automatic detection fails.

        endif # APP_ENABLE_CONSOLE

    endmenu # "Console Options"

    menu "lvgl Application Configuration"

        choice EXAMPLE_LCD_CONTROLLER
            prompt "LCD controller model"
            default EXAMPLE_LCD_CONTROLLER_ILI9341
            help
                Select LCD controller model

            config EXAMPLE_LCD_CONTROLLER_ILI9341
                bool "ILI9341"

            config EXAMPLE_LCD_CONTROLLER_GC9A01
                bool "GC9A01"

            config EXAMPLE_LCD_CONTROLLER_ST7789
                bool "ST7789"

        endchoice

        config EXAMPLE_LCD_TOUCH_ENABLED
            bool "Enable LCD touch"
            default n
            help
                Enable this option if you wish to use display touch. You can select from touch controllers.

        choice EXAMPLE_LCD_TOUCH_CONTROLLER
            prompt "LCD touch controller model"
            depends on EXAMPLE_LCD_TOUCH_ENABLED
            default EXAMPLE_LCD_TOUCH_CONTROLLER_STMPE610
            help
                Select LCD touch controller model

            config EXAMPLE_LCD_TOUCH_CONTROLLER_STMPE610
                bool "STMPE610"
                help
                    Touch controller STMPE610 connected via SPI.
        endchoice

    endmenu

    menu "esp32Cam Configuration"
        config ESP_WIFI_SSID
            string "WiFi STA SSID"
            default ""
            help
            WiFi SSID (network name) to connect to or empty for Off.

        config ESP_WIFI_PASSWORD
            string "WiFi STA Password"
            default ""
            help
            WiFi Password if WEP/WPA/WPA2 or empty if Open.

        config ESP_WIFI_AP_SSID
            string "WiFi AP SSID"
            default "ESP32-Camera"
            help
            AP SSID (network name) to create or empty for Off.

        config ESP_WIFI_AP_PASSWORD
            string "WiFi AP Password"
            default ""
            help
            AP password for WPA2 or empty for Open.

        config MAX_STA_CONN
            int "Maximal STA connections"
            default 1
            help
            Max number of the STA connects to AP.

        config ESP_WIFI_AP_CHANNEL
            string "WiFi AP Channel"
            default ""
            help
            AP channel for better connection performance.

        config SERVER_IP
            string "WiFi AP IP Address"
            default "192.168.4.1"
            help
                IP address that the ESP will assign to it's AP interface. You can use this IP to connect to the camera after flashing.

        config ESP_MAXIMUM_RETRY
            int "Maximum retry"
            default 5
            help
            Set the Maximum retry to avoid station reconnecting to the AP unlimited when the AP is really inexistent.
            
    endmenu
endmenu
```

## examples/_my_examples/Template/base_spilcd_rtsp_cam_template/sdkconfig.defaults
```kconfig
# ESP32S3
CONFIG_IDF_TARGET="esp32s3"
CONFIG_IDF_TARGET_ESP32S3=y
CONFIG_ESP32S3_DEFAULT_CPU_FREQ_240=y

# SPI flash
CONFIG_ESPTOOLPY_FLASHSIZE_16MB=y
CONFIG_ESPTOOLPY_FLASHMODE_QIO=y
CONFIG_ESPTOOLPY_FLASHMODE="qio"

CONFIG_ESP_SYSTEM_PANIC_PRINT_HALT=y

## LOG
# Reduce bootloader log verbosity
# CONFIG_BOOTLOADER_LOG_LEVEL_WARN=y
# CONFIG_BOOTLOADER_LOG_LEVEL=2
# CONFIG_LOG_DEFAULT_LEVEL_WARN=y
CONFIG_LOG_COLORS=y

# Increase main task stack size
CONFIG_ESP_MAIN_TASK_STACK_SIZE=7168
CONFIG_FREERTOS_TIMER_TASK_STACK_DEPTH=4096

# Enable filesystem
CONFIG_PARTITION_TABLE_CUSTOM=y
CONFIG_PARTITION_TABLE_CUSTOM_FILENAME="partitions_example.csv"
CONFIG_PARTITION_TABLE_FILENAME="partitions_example.csv"

# Enable FreeRTOS stats formatting functions, needed for 'tasks' command
CONFIG_FREERTOS_USE_TRACE_FACILITY=y
CONFIG_FREERTOS_USE_STATS_FORMATTING_FUNCTIONS=y
# Enable CPU usage
CONFIG_FREERTOS_GENERATE_RUN_TIME_STATS=y

# On chips with USB serial, disable secondary console which does not make sense when using console component
CONFIG_ESP_CONSOLE_SECONDARY_NONE=y

# LVGL
CONFIG_LV_CONF_SKIP=y
CONFIG_LV_USE_OBSERVER=y
CONFIG_LV_USE_SYSMON=y
CONFIG_EXAMPLE_LCD_CONTROLLER_ST7789=y
CONFIG_LV_USE_DEMO_WIDGETS=y
CONFIG_LV_USE_PERF_MONITOR=y
```
