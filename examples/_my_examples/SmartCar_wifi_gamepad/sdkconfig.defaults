## examples/_my_examples/Template/base_spilcd_rtsp_cam_template_v0.1/main/Kconfig.projbuild
```kconfig
menu "Application Configuration"

    orsource "$IDF_PATH/examples/_my_examples/common/APL/apl_console/Kconfig.apl_console"

    menu "lvgl Application Configuration"

        choice EXAMPLE_LCD_CONTROLLER
            prompt "LCD controller model"
            default EXAMPLE_LCD_CONTROLLER_ILI9341
            help
                Select LCD controller model

            config EXAMPLE_LCD_CONTROLLER_ILI9341
                bool "ILI9341"

            config EXAMPLE_LCD_CONTROLLER_GC9A01
                bool "GC9A01"

            config EXAMPLE_LCD_CONTROLLER_ST7789
                bool "ST7789"

        endchoice

        config EXAMPLE_LCD_TOUCH_ENABLED
            bool "Enable LCD touch"
            default n
            help
                Enable this option if you wish to use display touch. You can select from touch controllers.

        choice EXAMPLE_LCD_TOUCH_CONTROLLER
            prompt "LCD touch controller model"
            depends on EXAMPLE_LCD_TOUCH_ENABLED
            default EXAMPLE_LCD_TOUCH_CONTROLLER_STMPE610
            help
                Select LCD touch controller model

            config EXAMPLE_LCD_TOUCH_CONTROLLER_STMPE610
                bool "STMPE610"
                help
                    Touch controller STMPE610 connected via SPI.
        endchoice

        config LCD_SPI_USE_IOMUX_PINS
            bool "Use IOMUX pins for SPI interface of LCD"
            default y
            help
                Enable this option to use the built-in (IOMUX) pins for the SPI interface
                used by the LCD. If disabled, you can route SPI signals through GPIO matrix
                to any available GPIO.

                Enabling this option may result in better performance and lower CPU usage.

    endmenu

    menu "esp32Cam WIFI Configuration"
        config ESP_WIFI_SSID
            string "WiFi STA SSID"
            default ""
            help
            WiFi SSID (network name) to connect to or empty for Off.

        config ESP_WIFI_PASSWORD
            string "WiFi STA Password"
            default ""
            help
            WiFi Password if WEP/WPA/WPA2 or empty if Open.

        config ESP_WIFI_AP_SSID
            string "WiFi AP SSID"
            default "ESP32-Camera"
            help
            AP SSID (network name) to create or empty for Off.

        config ESP_WIFI_AP_PASSWORD
            string "WiFi AP Password"
            default ""
            help
            AP password for WPA2 or empty for Open.

        config MAX_STA_CONN
            int "Maximal STA connections"
            default 1
            help
            Max number of the STA connects to AP.

        config ESP_WIFI_AP_CHANNEL
            string "WiFi AP Channel"
            default ""
            help
            AP channel for better connection performance.

        config SERVER_IP
            string "WiFi AP IP Address"
            default "192.168.4.1"
            help
                IP address that the ESP will assign to it's AP interface. You can use this IP to connect to the camera after flashing.

        config ESP_MAXIMUM_RETRY
            int "Maximum retry"
            default 5
            help
            Set the Maximum retry to avoid station reconnecting to the AP unlimited when the AP is really inexistent.
            
    endmenu
endmenu
```

## examples/_my_examples/Template/base_spilcd_template/main/Kconfig.projbuild
```kconfig
menu "Application Configuration"

    orsource "$IDF_PATH/examples/_my_examples/common/APL/apl_console/Kconfig.apl_console"
    orsource "$IDF_PATH/examples/_my_examples/common/APL/apl_lvgl/Kconfig.apl_lvgl"

endmenu
```

## examples/_my_examples/Template/base_template/main/Kconfig.projbuild
```kconfig
menu "Application Configuration"

    menu "Console Options"

        config APP_ENABLE_CONSOLE
            bool "Enable Console Support"
            default y
            help
                Enable console command line support. This allows the application
                to accept commands via UART and execute them.

        if APP_ENABLE_CONSOLE

            config CONSOLE_STORE_HISTORY
                bool "Store command history in flash"
                default n
                help
                    Linenoise line editing library provides functions to save and load
                    command history. If this option is enabled, initializes a FAT filesystem
                    and uses it to store command history.

            config CONSOLE_IGNORE_EMPTY_LINES
                bool "Ignore empty lines inserted into the console"
                default y
                help
                    If an empty line is inserted to the console, the Console can either
                    ignore empty lines (the example would continue), or break on empty lines
                    (the example would stop after an empty line).

            config FORCE_SUPPORTS_ESCAPE_SEQ
                bool "Force support for terminal escape sequences"
                default y
                help
                    Some terminal programs support escape sequences (e.g., ANSI codes)
                    for color, cursor movement, and screen control. If this option is enabled,
                    the console will assume the terminal supports these escape sequences,
                    even if automatic detection fails.

        endif # APP_ENABLE_CONSOLE

    endmenu # "Console Options"

endmenu
```

## examples/_my_examples/Template/base_template/sdkconfig.defaults
```kconfig
CONFIG_IDF_TARGET="esp32s3"
CONFIG_IDF_TARGET_ESP32S3=y
CONFIG_ESP32S3_DEFAULT_CPU_FREQ_240=y

CONFIG_ESPTOOLPY_FLASHSIZE_16MB=y

# SPI flash
CONFIG_ESPTOOLPY_FLASHMODE_QIO=y
CONFIG_ESPTOOLPY_FLASHMODE="qio"

CONFIG_LOG_COLORS=y
CONFIG_ESP_SYSTEM_PANIC_PRINT_HALT=y

# LOG
# CONFIG_BOOTLOADER_LOG_LEVEL_WARN=y
# CONFIG_LOG_DEFAULT_LEVEL_WARN=y
```

## examples/_my_examples/common/APL/apl_console/Kconfig.apl_console
```kconfig
menu "Console Options"

    config APP_ENABLE_CONSOLE
        bool "Enable Console Support"
        default y
        help
            Enable console command line support. This allows the application
            to accept commands via UART and execute them.

    if APP_ENABLE_CONSOLE

        config CONSOLE_STORE_HISTORY
            bool "Store command history in flash"
            default n
            help
                Linenoise line editing library provides functions to save and load
                command history. If this option is enabled, initializes a FAT filesystem
                and uses it to store command history.

        config CONSOLE_IGNORE_EMPTY_LINES
            bool "Ignore empty lines inserted into the console"
            default y
            help
                If an empty line is inserted to the console, the Console can either
                ignore empty lines (the example would continue), or break on empty lines
                (the example would stop after an empty line).

    endif # APP_ENABLE_CONSOLE

endmenu # "Console Options"
```

## examples/_my_examples/get-started/hello_world/sdkconfig.defaults
```kconfig
CONFIG_IDF_TARGET_ESP32S3=y
CONFIG_ESP32S3_DEFAULT_CPU_FREQ_240=y

CONFIG_ESPTOOLPY_FLASHSIZE_16MB=y

CONFIG_FLASHMODE_QIO=y

CONFIG_ESP_SYSTEM_PANIC_PRINT_HALT=y
```

## examples/_my_examples/lcd/spi_lcd_touch/sdkconfig.defaults
```kconfig
CONFIG_LV_CONF_SKIP=y
CONFIG_LV_USE_OBSERVER=y
CONFIG_LV_USE_SYSMON=y

# add

CONFIG_IDF_TARGET="esp32s3"
CONFIG_IDF_TARGET_ESP32S3=y
CONFIG_ESP32S3_DEFAULT_CPU_FREQ_240=y

CONFIG_ESPTOOLPY_FLASHSIZE_16MB=y

# SPI flash
CONFIG_ESPTOOLPY_FLASHMODE_QIO=y
CONFIG_ESPTOOLPY_FLASHMODE="qio"

CONFIG_LOG_COLORS=y
CONFIG_ESP_SYSTEM_PANIC_PRINT_HALT=y

# LOG
# CONFIG_BOOTLOADER_LOG_LEVEL_WARN=y
# CONFIG_LOG_DEFAULT_LEVEL_WARN=y

CONFIG_EXAMPLE_LCD_CONTROLLER_ST7789=y

# LVGL
CONFIG_LV_USE_DEMO_WIDGETS=y
CONFIG_LV_USE_PERF_MONITOR=y
```

## examples/_my_examples/protocols/http_server/simple/sdkconfig.defaults
```kconfig
# ESP32S3
CONFIG_IDF_TARGET="esp32s3"
CONFIG_IDF_TARGET_ESP32S3=y
CONFIG_ESP32S3_DEFAULT_CPU_FREQ_240=y

CONFIG_EXAMPLE_WIFI_SSID="Xiaomi_ED74"
CONFIG_EXAMPLE_WIFI_PASSWORD="EzSY7G3R"

## LOG
# Reduce bootloader log verbosity
# CONFIG_BOOTLOADER_LOG_LEVEL_WARN=y
# CONFIG_BOOTLOADER_LOG_LEVEL=2
# CONFIG_LOG_DEFAULT_LEVEL_WARN=y
CONFIG_LOG_COLORS=y
```

## examples/_my_examples/wifi/getting_started/softAP/sdkconfig.defaults
```kconfig
# ESP32S3
CONFIG_IDF_TARGET="esp32s3"
CONFIG_IDF_TARGET_ESP32S3=y
CONFIG_ESP32S3_DEFAULT_CPU_FREQ_240=y
CONFIG_ESP32S3_DEFAULT_CPU_FREQ_MHZ=240

# SPI flash
CONFIG_ESPTOOLPY_FLASHSIZE_16MB=y
CONFIG_ESPTOOLPY_FLASHMODE_QIO=y
CONFIG_ESPTOOLPY_FLASHMODE="qio"
CONFIG_ESPTOOLPY_FLASHFREQ_80M=y

CONFIG_ESP_SYSTEM_PANIC_PRINT_HALT=y

## LOG
# Reduce bootloader log verbosity
# CONFIG_BOOTLOADER_LOG_LEVEL_WARN=y
# CONFIG_BOOTLOADER_LOG_LEVEL=2
# CONFIG_LOG_DEFAULT_LEVEL_WARN=y
CONFIG_LOG_COLORS=y

# Increase main task stack size
CONFIG_ESP_MAIN_TASK_STACK_SIZE=7168
CONFIG_FREERTOS_TIMER_TASK_STACK_DEPTH=4096

CONFIG_ESP_WIFI_SSID="myssid"
CONFIG_ESP_WIFI_PASSWORD=""
```
